#include "Solar2luna.h"



struct MONTH_INFO
{
	unsigned int N_AL_DT_DL : 5;
	unsigned int T_AL_DT_DL : 4;
	unsigned int SN_CT_AL : 1;
	unsigned int TN_B_THT : 1;
	unsigned int SN_CT_DL : 2;
};

union LUNAR_RECORD
{
	unsigned int Word;
	struct MONTH_INFO Info;
};

// Lunar Calendar Lookup Table
// From 1/1/2000 to 31/12/2099

//const PROGMEM long int LUNAR_CALENDAR_LOOKUP_TABLE[] = {
const long int LUNAR_CALENDAR_LOOKUP_TABLE[] = {
  0x1B76, 0x0997, 0x1A37, 0x1058, 0x1A79, 0x109A, 0x18BB, 0x1ADD, 0x1101, 0x1B21, 0x1142, 0x1B63 ,
  0x1B84, 0x0025, 0x1A44, 0x1065, 0x1A86, 0x10A7, 0x18C8, 0x1ACA, 0x10EB, 0x1B0C, 0x112D, 0x1B4E,
  0x1B6F, 0x0390, 0x182E, 0x1250, 0x1870, 0x1292, 0x18B2, 0x18D4, 0x12F6, 0x1916, 0x1138, 0x1B59,
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  0x1B7C, 0x019D, 0x1A3C, 0x125D, 0x187D, 0x12A1, 0x1AC1, 0x1AE3, 0x1104, 0x1B25, 0x1146, 0x1B67,
};

void converSolar2luna::Solar2Lunar(unsigned int SolarDate,unsigned int SolarMonth,unsigned int SolarYear) {
	int N_AL_DT_DL;
	int T_AL_DT_DL;
	int SN_CT_AL;
	int TN_B_THT;
	int N_AL_DT_DL_TT;
	int T_AL_DT_DL_TT;

	union LUNAR_RECORD lr;

	lr.Word = LUNAR_CALENDAR_LOOKUP_TABLE[(SolarYear - BEGINNING_YEAR) * 12 + SolarMonth - 1];
	N_AL_DT_DL = lr.Info.N_AL_DT_DL;
	T_AL_DT_DL = lr.Info.T_AL_DT_DL;
	SN_CT_AL = lr.Info.SN_CT_AL + 29;
	TN_B_THT = lr.Info.TN_B_THT;

	lr.Word = LUNAR_CALENDAR_LOOKUP_TABLE[(SolarYear - BEGINNING_YEAR) * 12 + SolarMonth];
	N_AL_DT_DL_TT = lr.Info.N_AL_DT_DL;
	T_AL_DT_DL_TT = lr.Info.T_AL_DT_DL;

	// Tinh ngay & thang
	if (N_AL_DT_DL == SN_CT_AL && N_AL_DT_DL_TT == 2) {
		if (SolarDate == 1) {
			(lunar_dd) = N_AL_DT_DL;
			(lunar_mm) = T_AL_DT_DL;
		} else if (SolarDate == 31) {
			(lunar_dd) = 1;
			(lunar_mm) = T_AL_DT_DL_TT;
		} else {
			(lunar_dd) = SolarDate - 1;
			if (TN_B_THT) {
				(lunar_mm) = T_AL_DT_DL;
			} else {
				(lunar_mm) = T_AL_DT_DL == 12 ? 1 :
					(T_AL_DT_DL + 1);
			}
		}
	} else {
		(lunar_dd) = SolarDate + N_AL_DT_DL - 1;
		if ((lunar_dd) <= SN_CT_AL) {
			(lunar_mm) = T_AL_DT_DL;
		} else {
			(lunar_dd) -= SN_CT_AL;

			(lunar_mm) = T_AL_DT_DL + 1 - TN_B_THT;
			if ((lunar_mm) == 13) (lunar_mm) = 1;
		}
	}

	// Tinh Nam
	if (SolarMonth >= (lunar_mm)) {
		(lunar_yy) = SolarYear;
	} else {
		(lunar_yy) = SolarYear - 1;
	}
}

unsigned int converSolar2luna::get_lunar_dd() {
	return lunar_dd;
}
unsigned int converSolar2luna::get_lunar_mm() {
	return lunar_mm;
}
unsigned int converSolar2luna::get_lunar_yy() {
	return lunar_yy;
}
